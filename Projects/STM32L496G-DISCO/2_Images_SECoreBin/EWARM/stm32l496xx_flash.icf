/*###ICF### Set of symbols used in SE and SB_SFU projects ****/

define memory mem with size = 4G;

/******************************************************************************/
/*       Include of SE symbols file                                           */
/*   (Project>Options>Linker>Extra Options --config_search option is used to  */
/*   specify the the directory to search for include files                    */
/******************************************************************************/
include "mapping_sbsfu.icf";
include "mapping_fwimg.icf";

initialize by copy { readwrite };
do not initialize  { section .noinit};
define block SE_VECTOR with alignment = 512 {readonly section .intvec };

/******************************************************************************/
/*                          placement instructions                            */
/******************************************************************************/
place at address mem:__ICFEDIT_SE_CallGate_region_ROM_start__ { readonly section .SE_CallGate_Code };
place at address mem:__ICFEDIT_SE_Key_region_ROM_start__ {readonly section .SE_Key_Data };
place at address mem:__ICFEDIT_SE_Startup_region_ROM_start__ { readonly section .SE_Startup_Code};
place in SE_ROM_region {readonly, block SE_VECTOR};
place in SE_RAM_region {readwrite};
